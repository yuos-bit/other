## drivers/mt7628e/config.in
```kconfig
if PACKAGE_kmod-mt7628ex212

config MT7628E_RT_SECOND_IF_MT7628E
	bool
	default y

config MT7628E_RT_FIRST_CARD
	int
	default 7603

config MT7628E_RT_SECOND_CARD
	int
	default 7628

config MT7628E_AP_LED
	bool
	default y

config MT7628E_AP_LLTD
	bool
	default y

config MT7628E_AP_WDS
	bool
	default y

config MT7628E_AP_MBSS
	bool
	default y

config MT7628E_AP_MBSS_NEW_MBSSID_MODE
	bool
	default y

config MT7628E_AP_APCLI
	bool
	default y

config MT7628E_AP_80211AC_VHT
	bool
        default y

config MT7628E_AP_TXBF_SUPPORT
	bool
        default n


endif
```
